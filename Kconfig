## Kconfig
```kconfig
# Add Kconfig definitions for your custom behaviors here.
# For each behavior, you'll need a set of lines like the ones below.
# Replace MY_BEHAVIOR and my-behavior with the actual names for your behavior.

DT_COMPAT_ZMK_BEHAVIOR_LANG_TOGGLE := zmk,behavior-lang-toggle

config ZMK_BEHAVIOR_LANG_TOGGLE
        bool "Language Toggle Behavior"
        default $(dt_compat_enabled,$(DT_COMPAT_ZMK_BEHAVIOR_LANG_TOGGLE))
```

## dts/bindings/behaviors/zmk,behavior-lang-toggle.yaml
```yaml
# Copyright (c) 2024 Your Name
# SPDX-License-Identifier: MIT

description: Behavior to toggle a global language state.

compatible: "zmk,behavior-lang-toggle"

properties:
  label:
    type: string
    description: "(Internal) Name for the behavior, used in generated defines"
    required: true
    deprecated: true

bindings:
  - name: behavior
    description: The behavior to activate

  '#binding-cells':
    type: int
    const: 0
    description: "(Internal) Number of parameters passed to the behavior in the keymap"
```
